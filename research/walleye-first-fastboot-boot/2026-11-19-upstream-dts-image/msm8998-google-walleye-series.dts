// SPDX-License-Identifier: GPL-2.0-only
/*
 * The series' board file with the two overlay-collision deletions (-series-base.dts), plus the empty stub nodes the bootloader's overlay merge needs
 * (generated by build/gen-overlay-stubs.sh from the base's dtb). Only for the image of walleye-upstream-dts-image.
 */
#include "msm8998-google-walleye-series-base.dts"
#include "msm8998-google-walleye-series-stubs.dtsi"
